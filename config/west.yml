## config/west.yml
```yaml
manifest:
  remotes:
    - name: zmkfirmware
      url-base: https://github.com/zmkfirmware
    - name: badjeff
      url-base: https://github.com/badjeff
    - name: m165437 #new entry
      url-base: https://github.com/M165437 #new entry
  projects:
    # - name: zmk
    #   remote: zmkfirmware
    #   revision: main
    #   import: app/west.yml
    - name: zmk
      remote: badjeff
      revision: abb64ba316c29caddc49727ca2cac2f0ed5970c7
      import: app/west.yml

    # ZMK modules
    - name: zmk-adaptive-key
      path: modules/zmk/adaptive-key
    - name: zmk-auto-layer
      path: modules/zmk/auto-layer
    - name: zmk-helpers
      path: modules/zmk/helpers
    - name: zmk-leader-key
      path: modules/zmk/leader-key
    - name: zmk-tri-state
      path: modules/zmk/tri-state
    - name: zmk-unicode
      path: modules/zmk/unicode

    - name: zmk-adns9800-driver
      remote: badjeff
      revision: main
    - name: zmk-pmw3610-driver
      remote: badjeff
      revision: main
    - name: zmk-analog-input-driver
      remote: badjeff
      revision: main
    - name: zmk-behavior-insomnia
      remote: badjeff
      revision: main
    - name: zmk-behavior-key-tempo
      remote: badjeff
      revision: main
    - name: zmk-behavior-mouse-key-toggle
      remote: badjeff
      revision: main
    - name: zmk-input-behavior-listener
      remote: badjeff
      revision: main
    - name: zmk-output-behavior-listener
      remote: badjeff
      revision: main
    - name: zmk-hid-io
      remote: badjeff
      revision: main
    - name: zmk-split-peripheral-input-relay
      remote: badjeff
      revision: main
    - name: zmk-split-peripheral-output-relay
      remote: badjeff
      revision: main
    - name: zmk-split-peripheral-bonding-tweak
      remote: badjeff
      revision: main
    - name: zmk-kscan-blackout
      remote: badjeff
      revision: main      
    - name: cirque-input-module
      remote: badjeff
      revision: main
    - name: nice-view-gem #new entry
      remote: m165437 #new entry
      revision: v0.3.0 #new entry
  self:
    path: config
```
